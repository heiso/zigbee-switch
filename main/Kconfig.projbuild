## main/Kconfig.projbuild
```kconfig
menu "ESP Zigbee Light Sleep Example"
    config GPIO_INPUT_IO_WAKEUP
        int "GPIO wakeup number"
        # https://docs.espressif.com/projects/esp-idf/en/stable/esp32c6/api-reference/peripherals/gpio.html#gpio-summary
        default 7 if IDF_TARGET_ESP32C6
        range 0 7 if IDF_TARGET_ESP32C6

endmenu
```
